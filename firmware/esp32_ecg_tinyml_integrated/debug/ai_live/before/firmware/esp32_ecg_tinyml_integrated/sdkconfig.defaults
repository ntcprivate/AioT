## firmware/esp32_ecg_tinyml_integrated/debug/ai_live/before/firmware/esp32_ecg_tinyml_integrated/sdkconfig.defaults
```kconfig
CONFIG_IDF_TARGET="esp32"
CONFIG_ESP_DEFAULT_CPU_FREQ_MHZ_240=y
CONFIG_ESP_MAIN_TASK_STACK_SIZE=8192
CONFIG_ESP_TFLITE_MICRO_USE_ESP_NN=y
CONFIG_ECG_HARDWARE_SELF_TEST=y
CONFIG_ECG_TELEMETRY=y
# CONFIG_ECG_OPERATOR_TRACE is not set
CONFIG_ECG_TRACE_SAMPLE=5
# CONFIG_ECG_ENABLE_EXPERIMENTAL_LIVE is not set
# CONFIG_ECG_GOLDEN_ALERT_DEMO is not set
```

## firmware/esp32_ecg_tinyml_integrated/debug/r_peak_phase2a_before/main/Kconfig.projbuild
```kconfig
menu "Integrated ECG experimental prototype"
config ECG_TELEMETRY
    bool "USB Serial batched telemetry for Windows Monitor (115200 baud)"
    default y
    help
        CRC32 frames, 32 actual timestamps/ADC/flags per packet, bounded queue.
        Sampling never waits for UART. Disables long operator/arithmetic dumps.
config ECG_SYNTHETIC_TELEMETRY_TEST
    bool "SYNTHETIC_TELEMETRY_TEST: known pattern, no sensor and no AI input"
    depends on ECG_TELEMETRY && !ECG_ENABLE_EXPERIMENTAL_LIVE
    default n
    help
        Same250Hz GPTimer/sampling task, queue and UART; replaces ADC read
        with deterministic512+(sample_index*17 modulo3072). Not ECG.
        Never calls pipeline_observe/pipeline_offer with synthetic samples.
config ECG_CONV_ARITHMETIC_LOG
    bool "Print three first-Conv arithmetic records outside Invoke"
    default y
    depends on !ECG_TELEMETRY
config ECG_CONV_DIAGNOSTIC_SAMPLE
    int "Golden sample for compact Conv diagnostics"
    depends on ECG_CONV_ARITHMETIC_LOG
    range 0 11
    default 5
config ECG_OPERATOR_TRACE
    bool "Capture operator output bytes for one golden sample (diagnostic)"
    default y
    depends on !ECG_TELEMETRY
    help
        Adds a bounded 24KiB diagnostic buffer. Captures via profiler callbacks
        before arena reuse, dumps after Invoke. No live inference or UART in ISR.
config ECG_TRACE_SAMPLE
    int "Golden sample index to trace"
    depends on ECG_OPERATOR_TRACE
    range 0 11
    default 5
config ECG_HARDWARE_SELF_TEST
    bool "LED/buzzer hardware self-test once at boot, independent of AI"
    default y
    help
        Clearly labeled hardware test: LED 2s, then six 150ms ON/350ms OFF
        LED/buzzer pulses. Sampling continues. Does not clear golden failure.
config ECG_ENABLE_EXPERIMENTAL_LIVE
    bool "Enable unvalidated R detector/live CNN for bench signal generator only"
    default n
    help
        Training used MIT-BIH annotation centers, not this detector. Requires
        detector/quality validation and golden tests before live claims.
config ECG_GOLDEN_ALERT_DEMO
    bool "Demonstrate LED/buzzer for golden model predictions at boot (TEST DATA)"
    depends on !ECG_HARDWARE_SELF_TEST
    depends on !ECG_TELEMETRY
    default n
config ECG_ARENA_KIB
    int "Internal tensor arena KiB"
    range 32 128
    default 64
config ECG_ADC_RAIL_MARGIN
    int "Reject ADC samples within this many counts of either rail"
    range 1 200
    default 16
config ECG_MIN_BLOCK_PTP
    int "Minimum block peak-to-peak ADC counts (bench heuristic)"
    range 1 1000
    default 20
config ECG_MAX_DIFF_PERCENT
    int "Maximum mean absolute difference as percent of peak-to-peak (bench heuristic)"
    range 1 100
    default 25
config ECG_QRS_MIN_COUNTS
    int "Minimum baseline-relative detector peak in ADC counts (bench heuristic)"
    range 1 1000
    default 30
endmenu
```

## firmware/esp32_ecg_tinyml_integrated/main/Kconfig.projbuild
```kconfig
menu "Integrated ECG experimental prototype"
config ECG_AI_LIVE
    bool
    depends on ECG_TELEMETRY && !ECG_AI_TEST_ONLY && !ECG_SYNTHETIC_TELEMETRY_TEST
    default y
    help
        Main research application ADC inference. Input safety/golden checks remain.
        Diagnostic TEST_ONLY and Synthetic builds never invoke ADC classification.
config ECG_AI_TEST_ONLY
    bool "Reference AI TEST_ONLY suite; never ADC-live or PVC alerts"
    depends on ECG_TELEMETRY
    default n
    help
        Reuses12 golden cases, adds8 FC14 regression cases and preprocessing/
        timing/memory measurements. Uses the existing model worker exclusively.
config ECG_BENCH_DEMO
    bool "BENCH DEMO: state-driven LED/buzzer; simulator only"
    depends on ECG_AI_LIVE && !ECG_HARDWARE_SELF_TEST && !ECG_GOLDEN_ALERT_DEMO
    default n
    help
        Requires a no-body bench/simulator setup. NORMAL: both 500ms on/off;
        PVC: LED steady, buzzer 200ms on/off; UNKNOWN/INVALID: LED off,
        buzzer 1000ms on/off; LEADS_OFF: LED steady, buzzer off.
        Physical feedback defaults disabled. No medical alarm.
config ECG_TELEMETRY
    bool "USB Serial batched telemetry for Windows Monitor (115200 baud)"
    default y
    help
        CRC32 frames, 32 actual timestamps/ADC/flags per packet, bounded queue.
        Sampling never waits for UART. Disables long operator/arithmetic dumps.
config ECG_SYNTHETIC_TELEMETRY_TEST
    bool "SYNTHETIC_TELEMETRY_TEST: known pattern, no sensor and no AI input"
    depends on ECG_TELEMETRY
    default n
    help
        Same250Hz GPTimer/sampling task, queue and UART; replaces ADC read
        with deterministic512+(sample_index*17 modulo3072). Not ECG.
        Never calls pipeline_observe/pipeline_offer with synthetic samples.
config ECG_CONV_ARITHMETIC_LOG
    bool "Print three first-Conv arithmetic records outside Invoke"
    default y
    depends on !ECG_TELEMETRY
config ECG_CONV_DIAGNOSTIC_SAMPLE
    int "Golden sample for compact Conv diagnostics"
    depends on ECG_CONV_ARITHMETIC_LOG
    range 0 11
    default 5
config ECG_OPERATOR_TRACE
    bool "Capture operator output bytes for one golden sample (diagnostic)"
    default y
    depends on !ECG_TELEMETRY
    help
        Adds a bounded 24KiB diagnostic buffer. Captures via profiler callbacks
        before arena reuse, dumps after Invoke. No live inference or UART in ISR.
config ECG_TRACE_SAMPLE
    int "Golden sample index to trace"
    depends on ECG_OPERATOR_TRACE
    range 0 11
    default 5
config ECG_HARDWARE_SELF_TEST
    bool "LED/buzzer hardware self-test once at boot, independent of AI"
    default n
    help
        Clearly labeled hardware test: LED 2s, then six 150ms ON/350ms OFF
        LED/buzzer pulses. Sampling continues. Does not clear golden failure.
config ECG_GOLDEN_ALERT_DEMO
    bool "Demonstrate LED/buzzer for golden model predictions at boot (TEST DATA)"
    depends on !ECG_HARDWARE_SELF_TEST
    depends on !ECG_TELEMETRY
    default n
config ECG_ARENA_KIB
    int "Internal tensor arena KiB"
    range 32 128
    default 64
config ECG_ADC_RAIL_MARGIN
    int "Reject ADC samples within this many counts of either rail"
    range 1 200
    default 16
config ECG_MIN_BLOCK_PTP
    int "Minimum block peak-to-peak ADC counts (bench heuristic)"
    range 1 1000
    default 20
config ECG_MAX_DIFF_PERCENT
    int "Maximum mean absolute difference as percent of peak-to-peak (bench heuristic)"
    range 1 100
    default 25
config ECG_QRS_MIN_COUNTS
    int "Minimum baseline-relative detector peak in ADC counts (bench heuristic)"
    range 1 1000
    default 30
endmenu
```

## firmware/esp32_tinyml_step8/main/Kconfig.projbuild
```kconfig
menu "ECG Step 8"
config ECG_ARENA_KIB
    int "Internal tensor arena (KiB)"
    range 16 128
    default 64
config ECG_REPEATS
    int "Timed Invoke calls per sample"
    range 30 100
    default 30
endmenu
```

## firmware/esp32_tinyml_step8/sdkconfig.defaults
```kconfig
CONFIG_IDF_TARGET="esp32"
CONFIG_ESP_DEFAULT_CPU_FREQ_MHZ_240=y
CONFIG_ESP_MAIN_TASK_STACK_SIZE=8192
CONFIG_ESP_TFLITE_MICRO_USE_ESP_NN=y
```
