## firmware/esp32_ecg_v4_experiment/sdkconfig.defaults
```kconfig
CONFIG_IDF_TARGET="esp32"
CONFIG_ESP_DEFAULT_CPU_FREQ_MHZ_160=y
CONFIG_ESPTOOLPY_FLASHSIZE_4MB=y
CONFIG_COMPILER_OPTIMIZATION_PERF=y
CONFIG_ESP_MAIN_TASK_STACK_SIZE=8192
CONFIG_ECG_AI_LIVE=y
CONFIG_ECG_TELEMETRY=y
CONFIG_ECG_ARENA_KIB=64
# CONFIG_ECG_BENCH_DEMO is not set
# CONFIG_ECG_OPERATOR_TRACE is not set
# CONFIG_ECG_CONV_ARITHMETIC_LOG is not set
# CONFIG_ECG_HARDWARE_SELF_TEST is not set
# CONFIG_ECG_AI_TEST_ONLY is not set
# CONFIG_ECG_SYNTHETIC_TELEMETRY_TEST is not set
```

## results/cnn_v4/esp32_golden_test/firmware/sdkconfig.defaults
```kconfig
CONFIG_IDF_TARGET="esp32"
CONFIG_ESP_MAIN_TASK_STACK_SIZE=8192
CONFIG_ESPTOOLPY_FLASHSIZE_4MB=y
CONFIG_ESPTOOLPY_FLASHSIZE="4MB"
CONFIG_COMPILER_OPTIMIZATION_PERF=y
CONFIG_LOG_DEFAULT_LEVEL_INFO=y
```
